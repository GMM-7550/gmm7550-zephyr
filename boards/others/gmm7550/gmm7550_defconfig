## boards/others/gmm7550/gmm7550_defconfig
```kconfig
CONFIG_LOG=y
CONFIG_CONSOLE=y
# CONFIG_BOOT_BANNER is not set
CONFIG_THREAD_RUNTIME_STATS=y
CONFIG_THREAD_RUNTIME_STATS_USE_TIMING_FUNCTIONS=y
CONFIG_DEVICE_DT_METADATA=y
CONFIG_UART_CONSOLE=y
CONFIG_GPIO_SHELL=y
CONFIG_I2C=y
CONFIG_I2C_SHELL=y
CONFIG_LED=y
CONFIG_LED_SHELL=y
CONFIG_LOG_CMDS=y
CONFIG_SHELL=y
# CONFIG_SHELL_DEVICE_HELPERS is not set
# CONFIG_SHELL_PROMPT_CHANGE is not set
# CONFIG_SHELL_STATS is not set
# CONFIG_SHELL_CMDS_RESIZE is not set
CONFIG_SHELL_CMDS_SELECT=y
# CONFIG_SHELL_LOG_OUTPUT_TIMESTAMP is not set
# CONFIG_SHELL_LOG_FORMAT_TIMESTAMP is not set
# CONFIG_SHELL_LOG_OUTPUT_LEVEL is not set
# CONFIG_SHELL_LOG_OUTPUT_THREAD is not set
# CONFIG_SHELL_CMDS_RETURN_VALUE is not set
# CONFIG_DEVICE_SHELL is not set
# CONFIG_DATE_SHELL is not set
CONFIG_SIZE_OPTIMIZATIONS_AGGRESSIVE=y
```
